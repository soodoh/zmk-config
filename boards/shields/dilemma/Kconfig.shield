## boards/shields/dilemma/Kconfig.shield
```kconfig
# Copyright (c) 2020 
# SPDX-License-Identifier: MIT

config SHIELD_DILEMMA_LEFT
    def_bool $(shields_list_contains,dilemma_left)

config SHIELD_DILEMMA_RIGHT
    def_bool $(shields_list_contains,dilemma_right)
```

## config/west.yml
```yaml
manifest:
  remotes:
    - name: zmkfirmware
      url-base: https://github.com/zmkfirmware
    - name: fork
      url-base: https://github.com/pauldiloreto
  projects:
    - name: zmk
      remote: fork
      revision: main
      import: app/west.yml
  self:
    path: config
```
